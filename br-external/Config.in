## br-external/Config.in
```kconfig
source "$BR2_EXTERNAL_TBOOT_LIVE_PATH/package/grub2-repo/Config.in"
source "$BR2_EXTERNAL_TBOOT_LIVE_PATH/package/tboot/Config.in"
```

## br-external/configs/tboot_live_defconfig
```kconfig
BR2_x86_64=y
BR2_TOOLCHAIN_BUILDROOT_GLIBC=y
BR2_PACKAGE_HOST_LINUX_HEADERS_CUSTOM_4_19=y
BR2_GCC_VERSION_8_X=y
BR2_TOOLCHAIN_BUILDROOT_CXX=y
BR2_TARGET_GENERIC_HOSTNAME="tboot-live"
BR2_TARGET_GENERIC_ISSUE="Welcome to TBOOT Live Image"
BR2_ROOTFS_DEVICE_CREATION_DYNAMIC_EUDEV=y
BR2_TARGET_GENERIC_GETTY_PORT="tty1"
BR2_ROOTFS_OVERLAY="$(BR2_EXTERNAL_TBOOT_LIVE_PATH)/board/tboot_live/rootfs_overlay"
BR2_ROOTFS_POST_IMAGE_SCRIPT="$(BR2_EXTERNAL_TBOOT_LIVE_PATH)/board/tboot_live/post-image-efi-gpt.sh"
BR2_LINUX_KERNEL=y
BR2_LINUX_KERNEL_USE_CUSTOM_CONFIG=y
BR2_LINUX_KERNEL_CUSTOM_CONFIG_FILE="$(BR2_EXTERNAL_TBOOT_LIVE_PATH)/board/tboot_live/linux.config"
BR2_LINUX_KERNEL_INSTALL_TARGET=y
BR2_LINUX_KERNEL_NEEDS_HOST_OPENSSL=y
BR2_PACKAGE_BUSYBOX_CONFIG="$(BR2_EXTERNAL_TBOOT_LIVE_PATH)/board/tboot_live/busybox.config"
BR2_PACKAGE_LINUX_FIRMWARE=y
BR2_PACKAGE_LINUX_FIRMWARE_ATHEROS_9170=y
BR2_PACKAGE_LINUX_FIRMWARE_ATHEROS_9271=y
BR2_PACKAGE_LINUX_FIRMWARE_IWLWIFI_3160=y
BR2_PACKAGE_LINUX_FIRMWARE_IWLWIFI_3168=y
BR2_PACKAGE_LINUX_FIRMWARE_IWLWIFI_5000=y
BR2_PACKAGE_LINUX_FIRMWARE_IWLWIFI_6000G2A=y
BR2_PACKAGE_LINUX_FIRMWARE_IWLWIFI_6000G2B=y
BR2_PACKAGE_LINUX_FIRMWARE_IWLWIFI_7260=y
BR2_PACKAGE_LINUX_FIRMWARE_IWLWIFI_7265D=y
BR2_PACKAGE_LINUX_FIRMWARE_IWLWIFI_8000C=y
BR2_PACKAGE_LINUX_FIRMWARE_IWLWIFI_8265=y
BR2_PACKAGE_LINUX_FIRMWARE_RALINK_RT73=y
BR2_PACKAGE_LINUX_FIRMWARE_RALINK_RT2XX=y
BR2_PACKAGE_LINUX_FIRMWARE_RTL_81XX=y
BR2_PACKAGE_LINUX_FIRMWARE_RTL_87XX=y
BR2_PACKAGE_LINUX_FIRMWARE_RTL_88XX=y
BR2_PACKAGE_LINUX_FIRMWARE_RTL_8169=y
BR2_PACKAGE_ACPID=y
BR2_PACKAGE_CONNMAN=y
BR2_PACKAGE_CONNMAN_WIFI=y
BR2_PACKAGE_CONNMAN_CLIENT=y
BR2_PACKAGE_TPM_TOOLS=y
BR2_PACKAGE_TPM2_ABRMD=y
BR2_PACKAGE_TPM2_TOOLS=y
BR2_TARGET_ROOTFS_CPIO=y
BR2_TARGET_ROOTFS_CPIO_XZ=y
BR2_PACKAGE_HOST_DOSFSTOOLS=y
BR2_PACKAGE_HOST_E2FSPROGS=y
BR2_PACKAGE_HOST_MTOOLS=y
BR2_PACKAGE_GRUB2_REPO=y
BR2_TARGET_GRUB2_REPO_X86_64_EFI=y
BR2_TARGET_GRUB2_REPO_BUILTIN_MODULES="boot linux ext2 fat squash4 part_msdos part_gpt normal relocator multiboot2 all_video gfxterm video font echo"
BR2_PACKAGE_TBOOT=y
```

## br-external/package/tboot/Config.in
```kconfig
config BR2_PACKAGE_TBOOT
	bool "tboot"
	select BR2_PACKAGE_TROUSERS
	help
	  Trusted Boot (tboot) is an open source, pre- kernel/VMM module
	  that uses Intel(R) Trusted Execution Technology (Intel(R) TXT)
	  to perform a measured and verified launch of an OS kernel/VMM.

	  https://sourceforge.net/projects/tboot/
```
